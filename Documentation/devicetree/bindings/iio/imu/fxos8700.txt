## Documentation/devicetree/bindings/iio/imu/fxos8700.txt
```
Freescale FXOS8700 - Inertial Measurement Unit with Accelerometer and Magnetometer

https://www.nxp.com/products/sensors/motion-sensors/6-axis/digital-motion-sensor-3d-accelerometer-2g-4g-8g-plus-3d-magnetometer:FXOS8700CQ

Required properties:
 - compatible : must be "fsl,fxos8700"
 - reg : the I2C address or SPI chip select number of the device
 - spi-max-frequency : set maximum clock frequency (only for SPI)

Example:

bmi160@1e {
	compatible = "fsl,fxos8700";
	reg = <0x1e>;
};
```

## Documentation/devicetree/bindings/video/fsl,bt656.txt
```
* Freescale BT656/BT1120 interface output

Required properties for bt656 on specified board:
- compatible: should be "fsl,bt656"
- reg: <base addr, range> contains pxp register base address and range
- default_ifmt: BT656|BT1120 - input format
- ipu_id: 0|1
- disp_id: 0|1
- status: should be set to "okay" if want to use bt656

Examples:
	bt656: bt656@0 {
		compatible = "fsl,bt656";
		default_ifmt = "BT656";
		ipu_id = <1>;
		disp_id = <0>;
		pinctrl-names = "default";
		pinctrl-0 = <&pinctrl_ipu2_2>;
		status = "okay";
	};
```
