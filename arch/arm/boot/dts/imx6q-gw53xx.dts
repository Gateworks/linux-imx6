/*
 * Copyright 2013-2014 Gateworks Corporation
 *
 * The code contained herein is licensed under the GNU General Public
 * License. You may obtain a copy of the GNU General Public License
 * Version 2 or later at the following locations:
 *
 * http://www.opensource.org/licenses/gpl-license.html
 * http://www.gnu.org/copyleft/gpl.html
 */

/dts-v1/;

#include "imx6q.dtsi"
#include "imx6qdl-gw53xx.dtsi"

/ {
	model = "Gateworks Ventana i.MX6 Dual/Quad GW53XX";
	compatible = "gw,imx6q-gw53xx", "gw,ventana", "fsl,imx6q";
};

/* /dev/video0: IPU2_CSI1 - Analog in via ADV7180 */
&cap0 {
	ipu_id = <1>;
	csi_id = <1>;
};

&sata {
	status = "okay";
};

/* Analog VideoIn IPU2_CSI1 */
&videoin {
	pinctrl-names = "default";
	pinctrl-0 = <&pinctrl_ipu2_3>; /* IPU2_CSI1 8bit */
	/* ipu_id/csi_id used to match up with v4l2_cap_<n> */
	ipu_id = <1>;
	csi_id = <1>;
};

